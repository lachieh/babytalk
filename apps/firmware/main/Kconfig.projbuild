## apps/firmware/main/Kconfig.projbuild
```kconfig
menu "Bubsie"

    config BUBSIE_DEFAULT_WEB_URL
        string "Factory web URL"
        default "https://bubsie.app"
        help
            The Bubsie instance a new or reset device pairs with. The API URL is read from
            <web URL>/.well-known/config. scripts/build.sh sets this from BUBSIE_WEB_URL.

    config BUBSIE_UI_TRACE
        bool "Log where each touch target is"
        default n
        help
            After a screen loads or a list stops scrolling, log "ui: at X,Y <label>" for every
            touch target on the glass, so the emulator tests can tap by label.

endmenu
```
